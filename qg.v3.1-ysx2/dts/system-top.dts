/*
 * CAUTION: This file is automatically generated by Xilinx.
 * Version: XSCT 2019.1
 * Today is: Sat Aug 24 05:30:11 2019
 */


/dts-v1/;
#include "zynq-7000.dtsi"
#include "pl.dtsi"
#include "pcw.dtsi"
/ {
	chosen {
		bootargs = "root=/dev/ram rw earlycon";
		stdout-path = "serial0:115200n8";
	};
	aliases {
		ethernet0 = &axi_eth_gmii0;
		ethernet1 = &axi_eth_gmii1;
		ethernet2 = &axi_eth_gmii2;
		ethernet3 = &axi_eth_sfp0;
		ethernet4 = &axi_eth_sfp1;
		ethernet5 = &gem0;
		i2c0 = &i2c0;
		serial0 = &uart1;
	};
	memory {
		device_type = "memory";
		reg = <0x0 0x40000000>;
	};
};
